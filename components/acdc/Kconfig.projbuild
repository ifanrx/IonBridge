## components/acdc/Kconfig.projbuild
```kconfig
menu "ACDC Configuration"

    orsource "$IDF_PATH/examples/common_components/env_caps/$IDF_TARGET/Kconfig.env_caps"

    config ACDC_MODULE
        bool "Enable ACDC Module"
        default n
        help
            Enable the ACDC module for power management.
            This module is responsible for managing the power supply.

    config ACDC_OUTPUT_ADJUSTABLE
        bool "ACDC Output Adjustable"
        depends on ACDC_MODULE
        default y
        help
            Enable adjustable output for the ACDC module.
            This allows the output voltage to be adjusted based on the configuration.

    config ACDC_CURRENT_VOLTAGE_CONTROL
        bool "Current-based Voltage Control"
        depends on ACDC_MODULE && ACDC_OUTPUT_ADJUSTABLE
        default n
        help
            Enable current-based voltage control using PD negotiated current
            and measured Iout values. When enabled, the system monitors total
            port current demand and adjusts voltage levels accordingly.

    config ACDC_CURRENT_MAX_LEVEL0
        int "Max current for Level 0 (mA)"
        depends on ACDC_CURRENT_VOLTAGE_CONTROL
        default 6000
        help
            Maximum current capacity in mA for voltage level 0.

    config ACDC_CURRENT_MAX_LEVEL1
        int "Max current for Level 1 (mA)"
        depends on ACDC_CURRENT_VOLTAGE_CONTROL
        default 6000
        help
            Maximum current capacity in mA for voltage level 1.

    config ACDC_CURRENT_MAX_LEVEL2
        int "Max current for Level 2 (mA)"
        depends on ACDC_CURRENT_VOLTAGE_CONTROL
        default 5500
        help
            Maximum current capacity in mA for voltage level 2.

    config ACDC_CURRENT_MAX_LEVEL3
        int "Max current for Level 3 (mA)"
        depends on ACDC_CURRENT_VOLTAGE_CONTROL && ACDC_OUTPUT_VOLTAGE_LEVELS > 3
        default 5500
        help
            Maximum current capacity in mA for voltage level 3.

    config ACDC_FEEDBACK_SIGNAL_H
        int "ACDC Feedback Signal High"
        depends on ACDC_MODULE
        range 0 1
        default 1
        help
            ACDC feedback signal high level.
            This setting determines the high level of the feedback signal.
            0: Low, 1: High.

    config ACDC_FEEDBACK_SIGNAL_L
        int "ACDC Feedback Signal Low"
        depends on ACDC_MODULE
        range 0 1
        default 0
        help
            ACDC feedback signal low level.
            This setting determines the low level of the feedback signal.
            0: Low, 1: High.

    config ACDC_FEEDBACK_PIN0
        int "ACDC Feedback Pin 0"
        depends on ACDC_MODULE
        range 0 21
        default 20
        help
            GPIO pin number for ACDC feedback signal 0.
            This pin is used to monitor the feedback from the ACDC module.

    config ACDC_FEEDBACK_PIN1
        int "ACDC Feedback Pin 1"
        depends on ACDC_MODULE && ACDC_OUTPUT_VOLTAGE_LEVELS > 2
        range 0 21
        default 21
        help
            GPIO pin number for ACDC feedback signal 1.
            This pin is used to monitor the feedback from the ACDC module.

    config ACDC_OUTPUT_VOLTAGE_LEVELS
        int "ACDC Output Voltage Levels"
        depends on ACDC_MODULE
        default 3
        range 2 4
        help
            Number of output voltage levels for the ACDC module.
            This setting determines how many different voltage levels can be set.

    config ACDC_OUTPUT_VOLTAGE_LEVEL0
        int "ACDC Output Voltage Level 0, mV"
        depends on ACDC_MODULE && ACDC_OUTPUT_VOLTAGE_LEVELS > 0
        default 12000
        help
            Output voltage level 0 for the ACDC module.
            This value is used to set the first output voltage level.
            Units: mV.

    config ACDC_OUTPUT_VOLTAGE_LEVEL1
        int "ACDC Output Voltage Level 1, mV"
        depends on ACDC_MODULE && ACDC_OUTPUT_VOLTAGE_LEVELS > 1
        default 20000
        help
            Output voltage level 1 for the ACDC module.
            This value is used to set the second output voltage level.
            Units: mV.

    config ACDC_OUTPUT_VOLTAGE_LEVEL2
        int "ACDC Output Voltage Level 2, mV"
        depends on ACDC_MODULE && ACDC_OUTPUT_VOLTAGE_LEVELS > 2
        default 28000
        help
            Output voltage level 2 for the ACDC module.
            This value is used to set the third output voltage level.
            Units: mV.

    config ACDC_OUTPUT_VOLTAGE_LEVEL3
        int "ACDC Output Voltage Level 3, mV"
        depends on ACDC_MODULE && ACDC_OUTPUT_VOLTAGE_LEVELS > 3
        default 30000
        help
            Output voltage level 3 for the ACDC module.
            This value is used to set the fourth output voltage level.
            Units: mV.

menu "ACDC Self-Test Voltage Tolerances"
        depends on ACDC_MODULE

        config ACDC_VOLTAGE_TOLERANCE_LOWER_L0
            int "Lower tolerance for Level 0 (mV)"
            depends on ACDC_OUTPUT_VOLTAGE_LEVELS > 0
            default 300
            help
                How far below expected voltage is acceptable at Level 0.
                Valid range: (expected - this, expected + upper_tolerance)

        config ACDC_VOLTAGE_TOLERANCE_UPPER_L0
            int "Upper tolerance for Level 0 (mV)"
            depends on ACDC_OUTPUT_VOLTAGE_LEVELS > 0
            default 300
            help
                How far above expected voltage is acceptable at Level 0.

        config ACDC_VOLTAGE_TOLERANCE_LOWER_L1
            int "Lower tolerance for Level 1 (mV)"
            depends on ACDC_OUTPUT_VOLTAGE_LEVELS > 1
            default 500
            help
                How far below expected voltage is acceptable at Level 1.

        config ACDC_VOLTAGE_TOLERANCE_UPPER_L1
            int "Upper tolerance for Level 1 (mV)"
            depends on ACDC_OUTPUT_VOLTAGE_LEVELS > 1
            default 500
            help
                How far above expected voltage is acceptable at Level 1.

        config ACDC_VOLTAGE_TOLERANCE_LOWER_L2
            int "Lower tolerance for Level 2 (mV)"
            depends on ACDC_OUTPUT_VOLTAGE_LEVELS > 2
            default 700
            help
                How far below expected voltage is acceptable at Level 2.

        config ACDC_VOLTAGE_TOLERANCE_UPPER_L2
            int "Upper tolerance for Level 2 (mV)"
            depends on ACDC_OUTPUT_VOLTAGE_LEVELS > 2
            default 700
            help
                How far above expected voltage is acceptable at Level 2.

        config ACDC_VOLTAGE_TOLERANCE_LOWER_L3
            int "Lower tolerance for Level 3 (mV)"
            depends on ACDC_OUTPUT_VOLTAGE_LEVELS > 3
            default 0
            help
                How far below expected voltage is acceptable at Level 3.

        config ACDC_VOLTAGE_TOLERANCE_UPPER_L3
            int "Upper tolerance for Level 3 (mV)"
            depends on ACDC_OUTPUT_VOLTAGE_LEVELS > 3
            default 1500
            help
                How far above expected voltage is acceptable at Level 3.

    endmenu

endmenu
```

## components/chip_data_types/Kconfig.projbuild
```kconfig
menu "FPGA ADC Configuration"
comment "Only available with FPGA hardware"

config FPGA_ADC_CFGS_COUNT
    int "Number of FPGA ADC configurations"
    default 1
    range 1 4
    help
        This option specifies the number of FPGA ADC configurations that can be defined.
        Each configuration can have its own settings for ADC channels and other parameters.

config FPGA_ADC_CFG_DEFAULT
   int "Default FPGA ADC Configuration"
   default 0
   range 0 2
   help
       This option specifies the default FPGA ADC configuration to use.
       It should match one of the defined configurations (0, 1, or 2).

config FPGA_ADC_CFG0_THRESHOLD_LOW
    int "FPGA ADC Configuration 0 Threshold Low"
    depends on FPGA_ADC_CFGS_COUNT >= 1
    default 70
    range 0 255
    help
        ADC Threshold Low for FPGA Configuration 0.

config FPGA_ADC_CFG0_THRESHOLD_HIGH
    int "FPGA ADC Configuration 0 Threshold High"
    depends on FPGA_ADC_CFGS_COUNT >= 1
    default 75
    range 0 255
    help
        ADC Threshold High for FPGA Configuration 0.

config FPGA_ADC_CFG0_ACTION_DEADZONE
    int "FPGA ADC Configuration 0 Action Deadzone"
    depends on FPGA_ADC_CFGS_COUNT >= 1
    default 128
    range 0 255
    help
        Action Deadzone for FPGA Configuration 0.

config FPGA_ADC_CFG1_THRESHOLD_LOW
    int "FPGA ADC Configuration 1 Threshold Low"
    depends on FPGA_ADC_CFGS_COUNT >= 2
    default 70
    range 0 255
    help
        ADC Threshold Low for FPGA Configuration 1.

config FPGA_ADC_CFG1_THRESHOLD_HIGH
    int "FPGA ADC Configuration 1 Threshold High"
    depends on FPGA_ADC_CFGS_COUNT >= 2
    default 75
    range 0 255
    help
        ADC Threshold High for FPGA Configuration 1.

config FPGA_ADC_CFG1_ACTION_DEADZONE
    int "FPGA ADC Configuration 1 Action Deadzone"
    depends on FPGA_ADC_CFGS_COUNT >= 2
    default 128
    range 0 255
    help
        Action Deadzone for FPGA Configuration 1.

config FPGA_ADC_CFG2_THRESHOLD_LOW
    int "FPGA ADC Configuration 2 Threshold Low"
    depends on FPGA_ADC_CFGS_COUNT >= 3
    default 70
    range 0 255
    help
        ADC Threshold Low for FPGA Configuration 2.

config FPGA_ADC_CFG2_THRESHOLD_HIGH
    int "FPGA ADC Configuration 2 Threshold High"
    depends on FPGA_ADC_CFGS_COUNT >= 3
    default 75
    range 0 255
    help
        ADC Threshold High for FPGA Configuration 2.

config FPGA_ADC_CFG2_ACTION_DEADZONE
    int "FPGA ADC Configuration 2 Action Deadzone"
    depends on FPGA_ADC_CFGS_COUNT >= 3
    default 128
    range 0 255
    help
        Action Deadzone for FPGA Configuration 2.

config FPGA_ADC_CFG3_THRESHOLD_LOW
    int "FPGA ADC Configuration 3 Threshold Low"
    depends on FPGA_ADC_CFGS_COUNT >= 4
    default 70
    range 0 255
    help
        ADC Threshold Low for FPGA Configuration 3.

config FPGA_ADC_CFG3_THRESHOLD_HIGH
    int "FPGA ADC Configuration 3 Threshold High"
    depends on FPGA_ADC_CFGS_COUNT >= 4
    default 75
    range 0 255
    help
        ADC Threshold High for FPGA Configuration 3.

config FPGA_ADC_CFG3_ACTION_DEADZONE
    int "FPGA ADC Configuration 3 Action Deadzone"
    depends on FPGA_ADC_CFGS_COUNT >= 4
    default 128
    range 0 255
    help
        Action Deadzone for FPGA Configuration 3.

endmenu
```

## components/display/Kconfig.projbuild
```kconfig
menu "Display Configuration"

choice DISPLAY_DRIVER
    prompt "Display Driver"
    default DISPLAY_DRIVER_FPGA

    config DISPLAY_DRIVER_FPGA
        bool "FPGA"

    config DISPLAY_DRIVER_LVGL
        bool "LVGL"
        select ENABLE_BLE_AND_MQTT_MUTUAL_EXCLUSION

    config DISPLAY_DRIVER_GPU
        bool "GPU"

    config DISPLAY_DRIVER_NONE
        bool "None"
        help
            Disable display driver. This is useful for testing purposes or if you don't need a display.
            Note: This will disable all display-related features and functionality.
endchoice

config ANIMATION_FRAME_RATE
    int "Animation frame rate (FPS)"
    default 60
    range 1 120
    help
        Animation frame rate in frames per second. Higher values provide smoother
        animations but consume more CPU. Default is 60 FPS (16.667ms per frame).

config ANIMATION_FONT_DIR
    string "Animation Image Directory"
    default "/littlefs/resources/fonts"
    help
        Directory where the animation fonts are stored.

config ANIMATION_IMAGE_DIR
    string "Animation Image Directory"
    default "/littlefs/resources/images"
    help
        Directory where the animation images are stored.

config ANIMATION_IMAGE_EXT
    string "Animation Image File Extension"
    default ".sqoi" if DISPLAY_DRIVER_LVGL
    default ".bin"  if DISPLAY_DRIVER_GPU
    default ".bin"  if DISPLAY_DRIVER_FPGA
    default ".bin"
    help
        File extension for animation images.
        - LVGL: .sqoi (compressed format via esp_lv_decoder)
        - GPU:  .bin  (384-byte raw bitmap)
        - FPGA: .bin  (not currently used)

config BOOT_ANIMATION_PLAY_DURATION
    int "Boot Animation Play Duration(ms)"
    default 3000
    help
        Duration in milliseconds for boot animation (FPGA: hardcoded segments, LVGL/GPU: animated images).

config DEVICE_INFO_ANIMATION_PLAY_DURATION
    int "Device Info Animation Play Duration(ms)"
    default 5000
    help
        Duration in milliseconds for device info animation.

config IDLE_ANIMATION_PLAY_DURATION
    int "Idle Animation Play Duration(ms)"
    default 30000
    help
        Duration in milliseconds for idle animation.

config CODE_ANIMATION_PLAY_DURATION
    int "Code Animation Play Duration(ms)"
    default 60000
    help
        Duration in milliseconds for code animation.

config WIFI_CONNECTING_ANIMATION_PLAY_DURATION
    int "WiFi Connecting Animation Play Duration(ms)"
    default 6000
    help
        Duration in milliseconds for wifi connecting animation.

config DEVICE_INSERTED_ANIMATION_PLAY_DURATION
    int "Device Inserted Animation Play Duration(ms)"
    default 500
    help
        Duration in milliseconds for device inserted animation.

config DEVICE_REMOVED_ANIMATION_PLAY_DURATION
    int "Device Removed Animation Play Duration(ms)"
    default 500
    help
        Duration in milliseconds for device removed animation.

config POWER_CHART_ANIMATION_PLAY_DURATION
    int "Power Chart Animation Play Duration(ms)"
    default 60000
    help
        Duration in milliseconds for device power chart animation.

config CHARGING_ANIMATION_PLAY_DURATION
    int "Charging Animation Play Duration(ms)"
    default 300000
    help
        Duration in milliseconds for charging animation.

config DISPLAY_LOCK_TIMEOUT_MS
    int "Display Lock Timeout(ms)"
    default 1000
    help
        Timeout in milliseconds for display lock.

config ENABLE_LVGL_MEMORY_MONITOR
    bool "Enable LVGL Memory Monitor"
    default n
    help
        Enable memory monitor for LVGL. This is useful for debugging memory issues in LVGL.
        It will log memory usage statistics to the console during animation switch.

endmenu
```

## components/logging/Kconfig.projbuild
```kconfig
menu "Global Logging Settings"

config SYSLOG_HOST
    string "Syslog host"
    default "172.25.16.125"
    help
        The host of the syslog report.

config SYSLOG_HOST_FALLBACK_IP
    string "Syslog host fallback ip"
    default "120.232.156.194"
    help
        The host of the syslog report.

config SYSLOG_PORT
    int "Syslog port"
    default 1515
    help
        The port of the syslog report.

config SYSLOG_SEMAPHORE_TIMEOUT_MS
    int "Syslog semaphore timeout (ms)"
    default 1000
    help
        The timeout of the semaphore used to prevent multiple threads from sending
        logs to the same syslog server simultaneously.

config SYSLOG_MESSAGE_BUFFER_SIZE
    int "Syslog message buffer size"
    default 384
    range 128 1024
    help
        The size of the buffer used to store syslog messages before they are sent.
        This should be large enough to hold the largest expected log message.

config SYSLOG_COLLECTOR_BUFFER_SIZE
    int "Syslog collector buffer size"
    default 256
    range 128 512
    help
        The size of the buffer used to collect syslog messages before they are sent.
        This should be large enough to hold multiple log messages.

endmenu
```
