## components/storage/Kconfig.projbuild
```kconfig
menu "File System Configuration"

config FILE_SYSTEM_BASE_PATH
    string "File system base path"
    default "/littlefs"
    help
        The base path for the file system. This should be an absolute path
        that does not contain any subdirectories.

config TEMP_FOLDER_PATH
    string "Temp folder path"
    default "/littlefs/temp"
    help
        Path to the temporary folder that will be used by the application.

endmenu

menu "Firmware Sizes"
    config SW3566_FIRMWARE_SIZE
        int "SW3566 firmware uncompressed size (bytes)"
        default 0
        help
            Uncompressed size of SW3566 firmware. Set automatically by update_version.
            Used for decompression buffer allocation.

    config FPGA_FIRMWARE_SIZE
        int "FPGA firmware uncompressed size (bytes)"
        default 0
        help
            Uncompressed size of FPGA firmware. Set automatically by update_version.
            Used for decompression buffer allocation.
endmenu

menu "Storage Compression"
    choice STORAGE_COMPRESSION_TYPE
        prompt "Firmware compression type"
        default STORAGE_COMPRESSION_GZIP
        help
            Select the compression algorithm for firmware files (FPGA bitstream, SW3566).
            Compressed files (.gz or .xz) are automatically detected and decompressed
            at runtime by the storage layer.

        config STORAGE_COMPRESSION_NONE
            bool "No compression"
            help
                Store firmware as uncompressed .bin files.

        config STORAGE_COMPRESSION_GZIP
            bool "GZIP compression"
            help
                Use gzip compression (.gz files).
                Typical compression: ~51% size reduction.
                Memory: 32KB sliding window.
                Speed: Fast decompression.

        config STORAGE_COMPRESSION_XZ
            bool "XZ/LZMA compression"
            help
                Use XZ/LZMA compression (.xz files).
                Typical compression: ~62% size reduction.
                Memory: Configurable dictionary (4-64KB).
                Speed: Slower than gzip, better compression ratio.
    endchoice

    config STORAGE_DECOMPRESSION_CHUNK_SIZE
        int "Decompression chunk/buffer size (bytes)"
        default 16384
        range 1024 32768
        help
            Buffer size for streaming decompression. Larger buffers reduce
            decoder iterations and improve performance. Two buffers of this
            size are allocated during decompression (input + output).

    config STORAGE_COMPRESSION_XZ_DICT_SIZE
        int "XZ dictionary size (KB)"
        depends on STORAGE_COMPRESSION_XZ
        default 4
        range 4 64
        help
            LZMA dictionary size for XZ decompression. Must match or exceed
            the dictionary size used during compression. Larger dictionaries
            provide better compression but use more RAM.

            Common values:
            - 4KB: Minimal memory, lower compression
            - 8KB: Balanced (recommended)
            - 16KB: Better compression
            - 32KB+: Maximum compression, high memory use
endmenu
```

## sdkconfig.defaults
```kconfig
CONFIG_IDF_TARGET="esp32c3"
CONFIG_IDF_TARGET_ESP32C3=y
CONFIG_IDF_FIRMWARE_CHIP_ID=0x0005
CONFIG_APP_PROJECT_VER="0.9.11"
CONFIG_SW3566_FIRMWARE_NUMERIC_VERSION=2025121002
CONFIG_SW3566_FIRMWARE_SEMVER="0.3.16"
CONFIG_SW3566_EMBEDDED_CHECKSUM="78bddf95f670ac4f282594261081eb214eade6ae"
CONFIG_SW3566_FILE_SHA1="f8d65dcd8c1141b0933150be9822641e47411805"
CONFIG_FPGA_FIRMWARE_NUMERIC_VERSION=2025123122
CONFIG_FPGA_FIRMWARE_SEMVER="0.2.11"
CONFIG_ZRLIB_SEMVER="1.8.1"
CONFIG_COMPILER_OPTIMIZATION_SIZE=y
# CONFIG_ESP_WIFI_NVS_ENABLED is not set
CONFIG_ESP_WIFI_STATIC_RX_BUFFER_NUM=4
CONFIG_ESP_WIFI_DYNAMIC_RX_BUFFER_NUM=8
CONFIG_ESP_WIFI_DYNAMIC_TX_BUFFER_NUM=16
CONFIG_LWIP_TCP_SND_BUF_DEFAULT=5744
CONFIG_LWIP_TCP_WND_DEFAULT=5744
CONFIG_LWIP_TCP_RTO_TIME=800
# CONFIG_LWIP_TIMERS_ONDEMAND is not set
CONFIG_LWIP_MAX_SOCKETS=13
CONFIG_LWIP_TCP_TMR_INTERVAL=50
CONFIG_WIFI_RECONNECT_LOOP_INTERVAL_MS=600000
CONFIG_WIFI_ABORT_WAIT_MS=300000
CONFIG_ESP_MAIN_TASK_STACK_SIZE=4096
CONFIG_ESP_TIMER_TASK_STACK_SIZE=4096
CONFIG_ESP_SYSTEM_EVENT_TASK_STACK_SIZE=4096
CONFIG_FREERTOS_TASK_NOTIFICATION_ARRAY_ENTRIES=2
CONFIG_MQTT_USE_CUSTOM_CONFIG=y
CONFIG_MQTT_TASK_PRIORITY=20
CONFIG_MQTT_POLL_READ_TIMEOUT_MS=6000
CONFIG_MQTT_EVENT_QUEUE_SIZE=2
# CONFIG_LWIP_DHCP_DOES_ARP_CHECK is not set
CONFIG_IONBRIDGE_WIFI_MAX_TX_POWER=84
CONFIG_DEINIT_BLE_ON_STOP_ADVERTISING=y
CONFIG_WIFI_CONNECT_SET_BSSID=y
CONFIG_ENABLE_WEB_SERVER=y
CONFIG_HTTPD_MAX_REQ_HDR_LEN=1024
CONFIG_LWIP_NETIF_LOOPBACK=y
CONFIG_LWIP_LOOPBACK_MAX_PBUFS=4
CONFIG_LWIP_TCP_MSS=1200
CONFIG_LWIP_TCP_TMR_INTERVAL=80
CONFIG_LWIP_TCP_MSL=40000
CONFIG_BT_NIMBLE_MSYS_1_BLOCK_COUNT=4
CONFIG_BT_NIMBLE_MSYS_2_BLOCK_COUNT=0
CONFIG_BT_NIMBLE_MSYS_2_BLOCK_SIZE=0
CONFIG_BT_NIMBLE_TRANSPORT_ACL_FROM_LL_COUNT=12
CONFIG_APP_REPRODUCIBLE_BUILD=y
CONFIG_ENABLE_MQTT_TLS=y
CONFIG_MQTT_APP_URI="mqtts://iot-broker.ifanrusercontent.com:8883"
CONFIG_MQTT_APP_HOSTNAME="iot-broker.ifanrusercontent.com"
CONFIG_SW3566_FIRMWARE_SIZE=122880
CONFIG_FPGA_FIRMWARE_SIZE=192229
```
