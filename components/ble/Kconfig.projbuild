## components/ble/Kconfig.projbuild
```kconfig
# Kconfig

menu "NimBLE Configuration"

config SERVICE_UUID
    string "Service UUID"
    default "048e3f2e-e1a6-4707-9e74-a930e898a1ea"
    help
        The UUID for the service.

config CHARACTERISTIC_UUID_TX
    string "Characteristic UUID TX"
    default "148e3f2e-e1a6-4707-9e74-a930e898a1ea"
    help
        The UUID for the TX characteristic.

config CHARACTERISTIC_UUID_RX
    string "Characteristic UUID RX"
    default "248e3f2e-e1a6-4707-9e74-a930e898a1ea"
    help
        The UUID for the RX characteristic.

config BLE_TASK_STACK_SIZE
    int "BLE Task Stack Size"
    default 4096
    range 3072 8192
    help
        Define the stack size of BLE task.

config BLE_ATT_MTU
    int "BLE ATT Maximum Transmission Unit"
    default 527
    range 23 527
    help
        Define the maximum size of payload bytes that can be sent in a single
        ATT PDU. The valid range is from 23 to 527.

config BLE_DEFAULT_DEVICE_NAME
    string "BLE Default Device Name"
    default "CP02-UNINITIALIZED"
    help
        The default name for the BLE device. This name will be used as the
        device identifier in BLE advertisements and connections.

config BLE_PWR_TYPE_ADV
    int "ESP_BLE_PWR_TYPE_ADV power"
    default 11
    range 0 15
    help
    esp_power_level_t NimBLEDevice::setPower ESP_BLE_PWR_TYPE_ADV

config BLE_PWR_TYPE_SCAN
    int "ESP_BLE_PWR_TYPE_SCAN power"
    default 11
    range 0 15
    help
    esp_power_level_t NimBLEDevice::setPower ESP_BLE_PWR_TYPE_SCAN

config BLE_PWR_TYPE_DEFAULT
    int "ESP_BLE_PWR_TYPE_DEFAULT power"
    default 11
    range 0 15
    help
    esp_power_level_t NimBLEDevice::setPower ESP_BLE_PWR_TYPE_DEFAULT

config BLE_ADV_INTERVAL_MS
    int "BLE Advertising Interval (ms)"
    default 2000
    range 2000 65535
    help
        The interval at which the device will advertise. The valid range is from
        2000 to 65535.

config BLE_ADV_TIMER_INTERVAL
    int "BLE Advertising Timer Interval (seconds)"
    default 60
    range 0 65535
    help
        The interval at which the device will advertise. The valid range is from
        0 to 65535.

config BLE_ADV_DURATION_MS
    int "BLE Advertising Duration (ms)"
    default 5000
    range 0 65535
    help
        The duration of the advertisement. The valid range is from 0 to 65535.

endmenu
```

## components/controller/Kconfig.projbuild
```kconfig
menu "ESP Controller Configuration"

config FIRMWARE_HASH_LENGTH
    int "Firmware Hash Length"
    default 32
    help
        Length of the firmware hash.

config OTA_UPDATE_TIMEOUT
    int "OTA Update Timeout (ms)"
    default 60000
    help
        Timeout for the OTA update in milliseconds.

config OTA_CONFIRM_TIMEOUT
    int "OTA Confirm Timeout (ms)"
    default 90000
    help
        Timeout to confirm the OTA update in milliseconds.
        This value should be less than the value set for WATCHDOG_TIMEOUT.

config OTA_CONFIRM_REQUEST_TIMEOUT
    int "OTA Confirm Request Timeout (ms)"
    default 300000
    help
        Timeout to send the OTA confirm request in milliseconds.

config OTA_CONFIRM_REQUEST_INTERVAL
    int "OTA Confirm Request Interval (ms)"
    default 1000
    help
        Interval to check MQTT connection and send OTA confirm request in milliseconds.

endmenu
```

## components/firmware/Kconfig.projbuild
```kconfig
menu "Firmware Configuration"

config FIRMWARE_DOWNLOAD_ENDPOINT
    string "Firmware download endpoint"
    default ""
    help
        Firmware download endpoint

config FIRMWARE_DOWNLOAD_RECV_TIMEOUT
    int "Firmware download receive timeout (ms)"
    default 30000
    range 1000 60000
    help
        Firmware download receive timeout

config SKIP_DOWNLOAD_ENDPOINT_COMMON_NAME_CHECK
    bool "Skip common name check for download endpoint"
    default n
    help
        Skip common name check for download endpoint

config FIRMWARE_DOWNLOAD_RECV_BUFFER_SIZE
    int "Firmware download receive buffer size (bytes)"
    default 512
    range 128 4096
    help
        Firmware download receive buffer size

config FIRMWARE_DOWNLOAD_TASK_STACK_SIZE
    int "Firmware download task stack size (bytes)"
    default 8192
    range 1024 32768
    help
        Firmware download task stack size

config FIRMWARE_DOWNLOAD_TASK_PRIORITY
    int "Firmware download task priority"
    default 5
    range 0 10
    help
        Firmware download task priority

config FIRMWARE_DOWNLOAD_DATA_BUFFER_SIZE
    int "Firmware download data buffer size (bytes)"
    default 512
    range 128 4096
    help
        Firmware download data buffer size, must be multiple of 16.

config UPGRADE_TASK_STACK_SIZE
    int "Upgrade task stack size (bytes)"
    default 8192
    range 1024 32768
    help
        Upgrade task stack size

config UPGRADE_TASK_PRIORITY
    int "Upgrade task priority"
    default 5
    range 0 10
    help
        Upgrade task priority

endmenu

menu "HTTPS OTA Configuration"

config OTA_RECV_TIMEOUT
    int "HTTPS OTA Receive Timeout(ms)"
    default 30000
    help
        Timeout for OTA receive in ms.

config SKIP_COMMON_NAME_CHECK
    bool "Skip Common Name Check"
    default n
    help
        Skip Common Name Check

config ENABLE_PARTIAL_HTTP_DOWNLOAD
    bool "Enable partial HTTP download"
    default n
    help
        This enables use of Range header in esp_https_ota component.
        Firmware image will be downloaded over multiple HTTP requests.

config HTTP_REQUEST_SIZE
    int "HTTP request size"
    default MBEDTLS_SSL_IN_CONTENT_LEN
    depends on ENABLE_PARTIAL_HTTP_DOWNLOAD
    help
        This option specifies HTTP request size. Number of bytes specified
        in this option will be downloaded in single HTTP request.

config OTA_REBOOT_DELAY_MS
    int "After OTA update, reboot delay (ms)"
    default 5000
    help
        Delay in ms after OTA update to reboot

endmenu
```

## components/mqtt_app/Kconfig.projbuild
```kconfig
menu "MQTT App Configuration"

config ENABLE_MQTT_TLS
    bool "Enable MQTT TLS"
    default n
    help
        Enable MQTT TLS support.

config MQTT_APP_URI
    string "MQTT Broker URI"
    default "mqtt://localhost:1883"
    help
        The URI of the MQTT broker to connect to.

config MQTT_APP_FALLBACK_URI
    string "MQTT Broker fallback URI"
    default "mqtt://localhost:1883"
    help
        The fallback URI of the MQTT broker to connect to.

config MQTT_APP_HOSTNAME
    string "MQTT Broker HOSTNAME"
    default "localhost"
    help
        The HOSTNAME of the MQTT broker to connect to.

config MQTT_MAX_RECONNECT_ATTEMPTS
    int "MQTT MAX RECONNECT ATTEMPTS"
    default 10
    help
        Max reconnect attempts(doubled because counter will increase in both disconnect and error event)

config MQTT_MEMORY_DEBUG
    bool "Enable MQTT Memory Debugging"
    default n
    help
        Enable MQTT Memory Debugging Logs.

choice
    prompt "Select MQTT Protocol Version"
    default MQTT_PROTOCOL_V_5

config MQTT_PROTOCOL_V_3_1
    bool "MQTT 3.1"
    help
        Use MQTT Version 3.1 (MQTT_PROTOCOL_V_3_1) for MQTT communications.

config MQTT_PROTOCOL_V_3_1_1
    bool "MQTT 3.1.1"
    help
        Use MQTT Version 3.1.1 (MQTT_PROTOCOL_V_3_1_1) for MQTT communications.

config MQTT_PROTOCOL_V_5
    bool "MQTT 5.0"
    help
        Use MQTT Version 5.0 (MQTT_PROTOCOL_V_5) for MQTT communications.

endchoice

endmenu
```

## components/nvs_data/Kconfig.projbuild
```kconfig
menu "NVS Data Configuration"

# Display Mode Configuration
choice
    prompt "Display Mode"
    default DISPLAY_MODE_POWER_METER

config DISPLAY_MODE_OFF
    bool "Off"
    help
        Set display mode to OFF.

config DISPLAY_MODE_MANUAL
    bool "Manual"
    help
        Set display mode to MANUAL.

config DISPLAY_MODE_POWER_METER
    bool "Power Meter"
    help
        Set display mode to POWER_METER.

endchoice

# Setting to hold the numeric value based on the choice
config DISPLAY_MODE
    hex
    default "0x00" if DISPLAY_MODE_OFF
    default "0x01" if DISPLAY_ORDER_MANUAL
    default "0x02" if DISPLAY_MODE_POWER_METER
    help
        Numeric value corresponding to the selected display mode.

# Display Intensity Configuration
config DISPLAY_INTENSITY
    hex "Display Intensity"
    default "0x80"
    range 0x00 0xFF
    help
        Set the display intensity. It is an 8-bit value.

config DEFAULT_SYSLOG_REPORTING_ENABLED
    bool "Default Syslog Reporting Enabled"
    default y
    help
        Default syslog reporting enabled. If true, report to syslog; otherwise, do not report.

config ADC_THRESHOLD_LOW
    int "ADC Threshold Low"
    default 70
    range 0 255
    help
        ADC Threshold Low

config ADC_THRESHOLD_HIGH
    int "ADC Threshold High"
    default 75
    range 0 255
    help
        ADC Threshold High

config ACTION_DEADZONE
    int "Action Deadzone"
    default 128
    range 0 255
    help
        Action Deadzone
        
endmenu
```

## components/port/Kconfig.projbuild
```kconfig
menu "Port Configuration"

choice MCU_MODEL
    prompt "Select Port MCU model"
    default MCU_MODEL_SW3566

    config MCU_MODEL_SW3566
        bool "SW3566"

    config MCU_MODEL_SW3526_SW3536
        bool "SW3526/SW3536"

    config MCU_MODEL_FAKE_SW3566
        bool "Fake SW3566"

endchoice

if MCU_MODEL_SW3566
menu "SW3566 Configuration"

config SW3566_COUNT
    int "Number of SW3566 chips"
    default 5
    help
        Number of SW3566 chips

endmenu
endif

if MCU_MODEL_SW3526_SW3536
menu"SW3526/SW3536 Configuration"

config SW3526_COUNT
    int "Number of SW3526 chips"
    default 2
    help
        Number of SW3526 chips

config SW3536_COUNT
    int "Number of SW3536 chips"
    default 3
    help
        Number of SW3536 chips

endmenu
endif

if MCU_MODEL_FAKE_SW3566
menu "Fake SW3566 Configuration"

config FAKE_SW3566_COUNT
    int "Number of Fake SW3566 chips"
    default 5
    help
        Number of Fake SW3566 chips

endmenu
endif

config PORT_TRICKLE_CHARGING_THRESHOLD
    int "Port Trickle Charging Threshold"
    range 1 10
    default 3
    help
        Defines the threshold (in watts) for trickle charging on a port. When the
        port power consumption falls below this threshold, the system will enter
        trickle charging mode to maintain minimal power flow while avoiding
        unnecessary power consumption.

config PORT_TEMP_WARNING_THRESHOLD
    int "Port Temperature Warning Threshold"
    range 50 80
    default 70
    help
        Defines the temperature (in degrees Celsius) at which the port issues a
        warning. If the port temperature exceeds this threshold, the system will
        log a warning to indicate that the port is approaching a critical
        temperature, allowing for preventive measures.

config PORT_TEMP_ALERT_THRESHOLD
    int "Port Temperature Alert Threshold"
    range 75 90
    default 85
    help
        Defines the temperature (in degrees Celsius) at which the port issues an
        alert. If the port temperature exceeds this threshold, the system will
        initiate protective measures to reduce power or shut down the port to
        prevent overheating and damage.

config PORT_TEMP_MAX_THRESHOLD
    int "Port Maximum Temperature Threshold"
    range 80 100
    default 90
    help
        Defines the maximum temperature (in degrees Celsius) for the port. If the
        port temperature exceeds this threshold, the system will immediately
        shut down the port to prevent permanent damage from overheating.

config PORT_TEMP_COOLDOWN_TIME
    int "Port Temperature Cooldown Time"
    range 10 120
    default 30
    help
        Defines the cooldown time (in seconds) after reducing the power on a port due to
        high temperature. The system will wait for this amount of time before attempting
        to decrease the power again. This ensures the port has sufficient time to cool
        down before further adjustments are made.

config PORT_OVER_TEMP_DECREASE
    int "Power Decrease for Port Over Temperature"
    range 1 50
    default 10
    help
        Defines the amount (in watts) by which the system will decrease the port's
        power when the port exceeds the high temperature threshold. This ensures
        that the port reduces its power consumption to avoid overheating while
        maintaining safe operating conditions.

config PORT_MANAGER_EVENT_QUEUE_SIZE
    int "Port Manager Event Queue Size"
    range 1 100
    default 20
    help
        Defines the size of the event queue for the port manager.

config PORT_MANAGER_TASK_STACK_SIZE
    int "Port Manager Task Stack Size"
    range 1536 8192
    default 2048
    help
        Defines the stack size (in bytes) for the port manager task.

config PORT_MANAGER_EVENT_ENQUEUE_TIMEOUT_MS
    int "Port Manager Event Enqueue Timeout"
    range 10 1000
    default 100
    help
        Defines the timeout (in milliseconds) for the port manager to wait for
        the event queue to become available before giving up.

config PORT_MANAGER_EVENT_DEQUEUE_TIMEOUT_MS
    int "Port Manager Event Dequeue Timeout"
    range 10 1000
    default 100
    help
        Defines the timeout (in milliseconds) for the port manager to wait for
        the event queue to have an event before giving up.

config PORT_HISTORICAL_DATA_SIZE
    int "Port Historical Data Size"
    range 1 1000
    default 180
    help
        Defines the size (in minutes) of the historical data buffer for each port.

config PORT_HISTORICAL_DATA_SAMPLE_RATE
    int "Port Historical Data Sample Rate"
    range 1 120
    default 10
    help
        Defines the sample rate (in seconds) for the historical data buffer for each port.

config PORT_CHECKING_TIMER_MS
    int "Port Checking Timer Interval (ms)"
    default 5000
    help
      Timer interval in milliseconds for the CHECKING state.
      The system will send a keep-alive message after this interval if no response is received.

endmenu
```
