## components/uart/Kconfig.projbuild
```kconfig
menu "UART Configuration"

    orsource "$IDF_PATH/examples/common_components/env_caps/$IDF_TARGET/Kconfig.env_caps"

    config UART_PORT_NUM
        int "UART port number"
        range 0 2 if IDF_TARGET_ESP32 || IDF_TARGET_ESP32S3
        default 2 if IDF_TARGET_ESP32 || IDF_TARGET_ESP32S3
        range 0 1
        default 2
        help
            UART communication port number for the example.
            See UART documentation for available port numbers.

    config UART_BAUD_RATE
        int "UART communication speed"
        range 4800 921600
        default 115200
        depends on !FPGA_AS_UART_SWITCH
        help
            UART communication speed for Modbus example.

    # Configuration for UART Message Send Attempts
    config UART_MESSAGE_SEND_ATTEMPTS
        int "UART Message Send Attempts"
        range 1 100
        default 16
        help
            Specifies the number of attempts the system will make to send a UART message.
            Increasing this value can improve reliability in noisy environments,
            while decreasing it can reduce latency.

    config UART_CRITICAL_MESSAGE_SEND_ATTEMPTS
        int "UART Critical Message Send Attempts"
        range 1 100
        default 16
        help
            Specifies the number of attempts the system will make to send a UART message.
            Increasing this value can improve reliability in noisy environments,
            while decreasing it can reduce latency.

    # Configuration for UART Message Receive Attempts
    config UART_MESSAGE_RECV_ATTEMPTS
        int "UART Message Receive Attempts"
        range 1 10
        default 1
        help
            Specifies the number of attempts the system will make to receive a UART message.
            Increasing this value can improve message reception reliability,
            while decreasing it can reduce resource usage.

    # Configuration for UART Message Receive Timeout
    config UART_MESSAGE_RECV_TIMEOUT_MS
        int "UART Message Receive Timeout (ms)"
        range 1 1000
        default 15
        help
            Specifies the timeout duration in milliseconds for receiving a UART message.
            A shorter timeout can reduce latency, while a longer timeout can improve
            message reception reliability.

    config UART_CRITICAL_MESSAGE_RECV_TIMEOUT_MS
        int "UART Critical Message Receive Timeout (ms)"
        range 1 1000
        default 15
        help
            Specifies the timeout duration in milliseconds for receiving a UART message.
            A shorter timeout can reduce latency, while a longer timeout can improve
            message reception reliability.

    config UART_RXD
        int "UART RXD pin number"
        range ENV_GPIO_RANGE_MIN ENV_GPIO_IN_RANGE_MAX
        default 4
        help
            GPIO number for UART RX pin. See UART documentation for more information
            about available pin numbers for UART.

    config UART_RX_QUEUE_SIZE
        int "UART RX Queue Size"
        default 4
        range 1 16
        help
            This configuration defines the size of the RX queue for the UART communication.

    config UART_RX_QUEUE_ENQUEUE_TIMEOUT_MS
        int "UART RX Queue Enqueue Timeout (ms)"
        default 100
        range 10 1000
        help
            This configuration defines the timeout in milliseconds for enqueuing data into the
            RX queue. When the queue is full, the enqueue operation will block for this amount of
            time before returning an error.

    config UART_TXD
        int "UART TXD pin number"
        range ENV_GPIO_RANGE_MIN ENV_GPIO_OUT_RANGE_MAX
        default 5
        help
            GPIO number for UART TX pin. See UART documentation for more information
            about available pin numbers for UART.

    config UART_TX_BUFFER_ENABLE
        bool "Enable UART TX Buffer"
        default y
        help
            This configuration enables the use of a buffer for UART TX. If enabled, the UART
            driver will buffer the data and send it in batches. This can improve performance
            and reduce the number of times the TX pin is toggled.

    config UART_TX_TARGETS
        int "Maximum UART TX Targets"
        default 6
        range 1 100
        help
            This configuration defines the maximum number of targets that can be registered for
            messages to be sent over UART.

    config TASK_MAP_CAPACITY
        int "Task Map Capacity"
        default 100
        range 1 1000
        help
            This configuration defines the maximum number of tasks that can be stored in the Task Map.
            The Task Map holds the (addr, command) -> TaskHandle_t mappings. Set an appropriate
            capacity based on the expected number of tasks.

    config TASK_MAP_MUTEX_TIMEOUT_MS
        int "Task Map Mutex Timeout (ms)"
        default 1000
        range 1 10000
        help
            This configuration defines the timeout in milliseconds for acquiring the Task Map mutex.
            When accessing or modifying the Task Map, this timeout will be used to ensure the task
            does not wait indefinitely for the mutex.

    config FPGA_AS_UART_SWITCH
        bool "Use FPGA as UART Switch"
        default n
        help
          This configuration enables the use of an FPGA as a switch for UART communication.
          When enabled:
            - UART communication speed is fixed to 921600.
            - The baud rate setting becomes non-configurable to ensure optimal FPGA operation.

    config UART_COMM_DEBUG
        bool "UART Communication Debugging"
        default n
        help
            This configuration enables debugging messages for UART communication.

    config UART_COMM_DEBUG_DATA
        bool "UART Communication Debugging Data"
        default n
        help
            This configuration enables logging data for UART communication.

    config UART_STATE_DEBUG
        bool "UART State Debugging"
        default n
        help
            This configuration enables debugging messages for UART state.

    config SYSTEM_REBOOT_ON_UART_RESET
        bool "Reboot After UART State Reset"
        default n
        help
            This configuration enables a reboot after the UART state is reset. This can be useful
            for debugging purposes.

    config UART_EVENT_TASK_PRIORITY
        int "UART Event Task Priority"
        default 22
        range 1 23
        help
            This configuration defines the priority of the UART event task. The UART event task
            is responsible for handling events related to UART communication, such as message
            reception and transmission.

endmenu
```

## components/wifi/Kconfig.projbuild
```kconfig
menu "Wi-Fi Configuration"

config ENABLE_WEB_SERVER
    bool "Enable Web Server"
    default n
    help
        Enable Web Server.

config IONBRIDGE_WIFI_MAX_TX_POWER
    int "Max TX power"
    range 8 84
    default 34
    help
        See esp_wifi_set_max_tx_power

config IONBRIDGE_WIFI_DEFAULT_SSID
    string "Default Wi-Fi SSID"
    default ""
    help
        The default Wi-Fi SSID to use when connecting to an AP.

config IONBRIDGE_WIFI_DEFAULT_PASSWORD
    string "Default Wi-Fi Password"
    default ""
    help
        The default Wi-Fi password to use when connecting to an AP.

config ESP_WIFI_SCAN_LIST_SIZE
    int "Max size of scan list"
    range 0 20
    default 16
    help
        The size of array that will be used to retrieve the list of access points.

config ESP_WIFI_STA_START_TIMEOUT
    int "Wi-Fi Station start Timeout (in milliseconds)"
    default 30000
    help
        This option specifies the timeout for waiting for the Wi-Fi station to start.

config ESP_WIFI_STA_MAXIMUM_RETRY
    int "Maximum retry"
    default 2
    help
        Set the maximum retry value to prevent the station from continuously
        attempting to reconnect to the Access Point (AP) when the AP doesn't exist.

choice ESP_WIFI_SAE_MODE
    prompt "WPA3 SAE mode selection"
    default ESP_WPA3_SAE_PWE_BOTH
    help
        Select mode for SAE as Hunt and Peck, H2E or both.
    config ESP_WPA3_SAE_PWE_HUNT_AND_PECK
        bool "HUNT AND PECK"
    config ESP_WPA3_SAE_PWE_HASH_TO_ELEMENT
        bool "H2E"
    config ESP_WPA3_SAE_PWE_BOTH
        bool "BOTH"
endchoice

config ESP_WIFI_PW_ID
    string "PASSWORD IDENTIFIER"
    depends on  ESP_WPA3_SAE_PWE_HASH_TO_ELEMENT|| ESP_WPA3_SAE_PWE_BOTH
    default ""
    help
        password identifier for SAE H2E

choice ESP_WIFI_SCAN_AUTH_MODE_THRESHOLD
    prompt "WiFi Scan auth mode threshold"
    default ESP_WIFI_AUTH_OPEN
    help
        The weakest authmode to accept in the scan mode.
        This value defaults to ESP_WIFI_AUTH_WPA2_PSK in case password is present and ESP_WIFI_AUTH_OPEN is used.
        Please select ESP_WIFI_AUTH_WEP/ESP_WIFI_AUTH_WPA_PSK in case AP is operating in WEP/WPA mode.

    config ESP_WIFI_AUTH_OPEN
        bool "OPEN"
    config ESP_WIFI_AUTH_WEP
        bool "WEP"
    config ESP_WIFI_AUTH_WPA_PSK
        bool "WPA PSK"
    config ESP_WIFI_AUTH_WPA2_PSK
        bool "WPA2 PSK"
    config ESP_WIFI_AUTH_WPA_WPA2_PSK
        bool "WPA/WPA2 PSK"
    config ESP_WIFI_AUTH_WPA3_PSK
        bool "WPA3 PSK"
    config ESP_WIFI_AUTH_WPA2_WPA3_PSK
        bool "WPA2/WPA3 PSK"
    config ESP_WIFI_AUTH_WAPI_PSK
        bool "WAPI PSK"
endchoice

config SNTP_TIME_SERVER
    string "SNTP Server name"
    default "cn.pool.ntp.org"
    help
        Hostname of the main SNTP server.

choice SNTP_TIME_SYNC_METHOD
    prompt "Time synchronization method"
    default SNTP_TIME_SYNC_METHOD_IMMED
    help
        Select the method to synchronize the time.

    config SNTP_TIME_SYNC_METHOD_IMMED
        bool "update time immediately when received"
    config SNTP_TIME_SYNC_METHOD_SMOOTH
        bool "update time with smooth method (adjtime)"
    config SNTP_TIME_SYNC_METHOD_CUSTOM
        bool "custom implementation"
endchoice

config WIFI_RSSI_LOG_TIMER_INTERVAL
    int "RSSI log timer interval (in seconds)"
    default 60
    help
        The interval in seconds to log the RSSI value of the Wi-Fi connection.

config DEFAULT_WIFI_CONNECTION_DELAY
    int "Default wifi connection delay (in seconds)"
    default 180
    help
        Specifies the amount of time the system waits before attempting to connect to a default WiFi network.

config WIFI_RECORD_COUNT
    int "Number of Wi-Fi Records to Save"
    default 2
    help
        Specifies the number of Wi-Fi connection records to store. Each record includes SSID and password.

config WIFI_RECONNECT_INTERVAL_MS
    int "WiFi Reconnect Timer Interval (ms)"
    default 30000
    help
      Timer interval in milliseconds before attempting to reconnect to WiFi.
      You can adjust this value to control how frequently the system retries
      connecting to WiFi after a disconnect.

config GENERATE_204_URL_DOMESTIC
    string "GENERATE 204 URL DOMESTIC"
    default "http://wifi.vivo.com.cn/generate_204"
    help
        The URL of generate_204 service.

config GENERATE_204_URL_DOMESTIC_BACKUP
    string "GENERATE 204 URL DOMESTIC BACKUP"
    default "http://connect.rom.miui.com/generate_204"
    help
        The URL of generate_204 service.

config GENERATE_204_URL_GLOBAL
    string "GENERATE 204 URL GLOBAL"
    default "http://www.gstatic.com/generate_204"
    help
        The URL of generate_204 service.

config GENERATE_204_URL_GLOBAL_BACKUP
    string "GENERATE 204 URL GLOBAL BACKUP"
    default "http://captive.apple.com/generate_204"
    help
        The URL of generate_204 service.

config MQTT_FALLBACK_IP
    string "MQTT Fallback IP Address"
    default ""
    help
        Fallback IP address for the MQTT services

config WIFI_RECONNECT_LOOP_INTERVAL_MS
    int "WiFi Reconnect Loop Timer Interval (ms)"
    default 300000
    help
        Timer interval in milliseconds before attempting to next reconnect loop.

config DISPLAY_FLASH_INTERVAL_MS
    int "Display Flash Interval (ms)"
    default 300
    help
        This setting determines how frequently the display switches between on and off states during flashing sequences. 
        Flashing is typically used to indicate statuses such as ongoing Wi-Fi reconnection attempts.

endmenu
```
